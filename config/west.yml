## config/west.yml
```yaml
# ブランチ名やタグで参照しないのは(タグは付け替え可能)、上流が乗っ取られたときに
# west update だけで不正なコードがファームウェアに入るため。SHA を上げるときは
# 差分をレビューしてから: git -C <repo> log --oneline <古いSHA>..<新しいSHA>
#
# zmk が import する Zephyr までは固定できていない。塞ぐには zmk の manifest ごと
# 管理下に置く必要があり、そこまではやっていない。
manifest:
  remotes:
    - name: zmkfirmware
      url-base: https://github.com/zmkfirmware
    - name: caksoylar
      url-base: https://github.com/caksoylar
    - name: beekeeb
      url-base: https://github.com/beekeeb
    - name: odaryo
      url-base: https://github.com/odaryo
  projects:
    - name: zmk
      remote: zmkfirmware
      import: app/west.yml
      revision: edf5c0814fd3ea202e43aad2d68fd32e882a518c # tag v0.3
    - name: zmk-rgbled-widget
      remote: caksoylar
      revision: 8756cb7b8114069fa3c25c6f6c990f24988fceff # tag v0.3
    # 上流(beekeeb)をそのまま使わないのは、エッジスクロール用の report-absolute が
    # 無いため。分岐元は beekeeb main = c329f30。デフォルトブランチの master には
    # three-finger-swipe が入っていないので、そちらには戻さないこと。
    - name: zmk_driver_azoteq
      remote: odaryo
      revision: 57b4da9e70a1c0358020864f02f64e584ac415e8 # toucan-edge-scroll
    - name: zmk-input-zoom
      remote: beekeeb
      revision: 91bbe0c0e02145da50c9df798489479d28be1804 # main @ 2026-08-11
  self:
    path: config
```

## modules/toucan_input/dts/bindings/input_processors/zmk,input-processor-edge-scroll.yaml
```yaml
# Copyright (c) 2026 The ZMK Contributors
# SPDX-License-Identifier: MIT

description: |
  トラックパッドの端(既定では右端)に指を置いてなぞったときだけ、その動きを
  カーソル移動ではなくスクロールに変換する入力プロセッサ(エッジスクロール)。

  判定にはドライバが送る絶対座標を使うので、トラックパッド側で
  report-absolute = "touchdown" を有効にしておくこと。

  指を置いた瞬間の座標だけでエッジ帯の内外を判定してラッチする。途中で
  エッジ帯から外れてもスクロールは続き、指を離した時点で解除される。

  相対イベントのコードを差し替えるだけなので、後続に zip_scroll_scaler や
  慣性スクロールを置けばそのまま効く。チェーンの「先頭」に置くこと。

  例:
    edge_scroll: edge_scroll {
        compatible = "zmk,input-processor-edge-scroll";
        #input-processor-cells = <0>;
        position-code = <INPUT_ABS_X>;
        move-code = <INPUT_REL_Y>;
        scroll-code = <INPUT_REL_WHEEL>;
        edge-min = <1700>;
        edge-max = <65535>;
    };

compatible: "zmk,input-processor-edge-scroll"

include: ip_zero_param.yaml

properties:
  position-code:
    type: int
    default: 0  # INPUT_ABS_X
    description: |
      エッジを跨ぐ方向(右端判定なら横方向)の絶対座標コード。
      トラックパッドで switch-xy を有効にしていると、物理的な横方向が
      INPUT_ABS_Y 側になることがある。実機で確認すること。

  move-code:
    type: int
    default: 1  # INPUT_REL_Y
    description: |
      エッジに沿って指を動かす方向(右端なら縦方向)の相対イベントコード。
      position-code と直交する軸を指定する。

  scroll-code:
    type: int
    default: 8  # INPUT_REL_WHEEL
    description: 出力するスクロールのコード。縦スクロールなら INPUT_REL_WHEEL。

  edge-min:
    type: int
    required: true
    description: |
      エッジ帯の下限(position-code の生の絶対座標、この値を含む)。
      座標は 0 〜 (解像度 - 1) の範囲。解像度はドライバが起動時に
      "Active resolution: x=..., y=..." としてログに出力する。
      右端の 15% を帯にするなら、解像度 2048 に対して 1740 程度。

  edge-max:
    type: int
    required: true
    description: |
      エッジ帯の上限(この値を含む)。右端を帯にする場合は解像度より大きな値
      (例: 65535)を入れておけば上限を気にしなくてよい。左端を帯にするなら
      edge-min = <0> と小さめの edge-max を指定する。

  invert:
    type: boolean
    description: スクロール方向を反転する。
```

## modules/toucan_input/dts/bindings/input_processors/zmk,input-processor-scroll-momentum.yaml
```yaml
# Copyright (c) 2026 The ZMK Contributors
# SPDX-License-Identifier: MIT

description: |
  スクロール(ホイール)イベントに「2段階の速度」と「慣性(inertia)」を与える
  入力プロセッサ。

  - ゆっくりスワイプ: 何もしない(現在の速度そのまま)
  - 速くスワイプ: fast-gain 倍に加速し、指を離した後も減速しながら
    しばらくスクロールを続ける(慣性スクロール)

  慣性中のイベントはこのノード自身をデバイスとする専用の zmk,input-listener
  から送出されるため、トラックパッドのプロセッサチェーンを再通過しない。
  したがってこのプロセッサはチェーンの最後(スケーラや transform の後)に
  置くこと。

  例:
    scroll_momentum: scroll_momentum {
        compatible = "zmk,input-processor-scroll-momentum";
        #input-processor-cells = <0>;
        codes = <INPUT_REL_WHEEL INPUT_REL_HWHEEL>;
        track-remainders;
    };

    scroll_momentum_listener: scroll_momentum_listener {
        compatible = "zmk,input-listener";
        device = <&scroll_momentum>;
    };

compatible: "zmk,input-processor-scroll-momentum"

include: ip_zero_param.yaml

properties:
  codes:
    type: array
    required: true
    description: |
      対象の相対イベントコード(最大4個)。通常は
      <INPUT_REL_WHEEL INPUT_REL_HWHEEL>。

  fast-threshold:
    type: int
    default: 40
    description: |
      「速いスワイプ」と判定する速度のしきい値。単位は最終的なスクロール
      単位/秒(スケーラ適用後の値)。この値以上で fast-gain と慣性が有効になる。
      慣性が発動しない場合は下げ、通常スクロールで発動してしまう場合は上げる。

  fast-gain:
    type: int
    default: 1200
    description: |
      速いスワイプ「中」の速度倍率(パーミル)。1200 = 1.2倍。
      1000 にすると加速なし(慣性だけ)になる。

  coast-gain:
    type: int
    default: 1000
    description: |
      慣性の「開始速度」の倍率(パーミル)。指を離した瞬間の実測速度に対する倍率。
      1000 = 離した瞬間の速度のまま慣性に入る。慣性を弱めたいときはここを下げる。

  max-coast-speed:
    type: int
    default: 120
    description: |
      慣性の開始速度の上限(スクロール単位/秒)。非常に速いフリックで慣性が
      行き過ぎるのを防ぐ。慣性の移動量は概ね
      (開始速度 × tick-ms ÷ 1000) ÷ (1 - decay/1000) 単位。

  decay:
    type: int
    default: 850
    description: |
      慣性スクロールの1ティックあたりの速度残存率(パーミル)。
      850 なら1ティックごとに 85% に減速する。小さいほど早く止まる。

  tick-ms:
    type: int
    default: 25
    description: 慣性スクロール中にイベントを送出する間隔(ms)。

  release-ms:
    type: int
    default: 60
    description: |
      スクロールイベントが途切れてから「指が離れた」と判断するまでの時間(ms)。
      短すぎるとスワイプ中に慣性が発動し、長すぎると慣性の開始が遅れる。

  window-ms:
    type: int
    default: 120
    description: 速度を測定する移動平均ウィンドウ(ms)。

  max-duration-ms:
    type: int
    default: 1000
    description: 慣性スクロールを継続する最大時間(ms)。

  stop-on-move:
    type: boolean
    description: |
      カーソル移動(INPUT_REL_X / INPUT_REL_Y)を検知したときも慣性を止める。
      指を置いたら即止まる実機トラックパッドに近い挙動になるが、ドライバが
      スクロール中に X/Y も同時に出す場合は慣性が発動しなくなるため、その
      場合は無効にする。
```

## modules/toucan_input/dts/bindings/input_processors/zmk,input-processor-swipe-keys.yaml
```yaml
# Copyright (c) 2026 The ZMK Contributors
# SPDX-License-Identifier: MIT

description: |
  相対イベント(2本指スクロール)の移動量を軸ごとに積算し、しきい値を超えたら
  その軸の方向に応じた behavior を実行する入力プロセッサ。

  2本指スワイプを macOS のワークスペース切り替えや Mission Control などの
  ショートカットに割り当てる用途を想定している。発火は1ジェスチャにつき1回
  (throttle-ms = 0 の場合)で、ロックは軸をまたいで共有されるため、斜めの
  スワイプで縦横のショートカットが同時に出ることはない。

  対象イベントは既定で消費される(値が0になり、後続のプロセッサも走らない)ため
  同じスワイプが横スクロールとしても流れることはない。1本指スクロールに影響を
  与えないよう、zip_xy_to_scroll_mapper より「前」に置くこと(X/Y がホイールに
  変換される前ならトラックパッドの2本指スクロールだけが HWHEEL になる)。

  例:
    nav_swipe_mapper: nav_swipe_mapper {
        compatible = "zmk,input-processor-swipe-keys";
        #input-processor-cells = <0>;
        codes = <INPUT_REL_HWHEEL INPUT_REL_WHEEL>;
        threshold = <15>;
        bindings = <&kp LG(LS(LEFT))>, <&kp LG(LS(RIGHT))>,
                   <&kp LG(UP)>, <&kp LG(DOWN)>;
    };

compatible: "zmk,input-processor-swipe-keys"

include: ip_zero_param.yaml

properties:
  codes:
    type: array
    required: true
    description: |
      対象の相対イベントコード(最大4個)。2本指スワイプなら
      <INPUT_REL_HWHEEL INPUT_REL_WHEEL>(横, 縦)。

  threshold:
    type: int
    required: true
    description: |
      behavior を発火させるまでの積算移動量(ドライバが出す生の値の合計)。
      TPS43 トラックパッドの2本指スクロールでは1スワイプの合計が数十単位
      なので 15 前後が目安。大きくすると「もっと大きくスワイプしないと
      反応しない」。反応しない場合は下げ、勝手に発火する場合は上げる。
      CONFIG_ZMK_LOG_LEVEL_DBG=y でビルドすると毎イベントの積算値がログに出る。

      積算中にピークから threshold の半分以上引き返すと「逆方向のスワイプ」と
      みなして積算をやり直す。

  bindings:
    type: phandle-array
    required: true
    description: |
      codes の各軸に対して behavior を2つずつ、codes と同じ順で指定する
      (軸 i に対して bindings[2i] = 負方向、bindings[2i+1] = 正方向)。
      方向が逆になる場合はその軸の2つを入れ替える。

  timeout-ms:
    type: int
    default: 300
    description: |
      この時間だけ対象イベントが途切れたら「スワイプが終わった」とみなし、
      積算値と連射ロックをリセットする。ドライバは1レポートで縦横どちらか
      優勢な軸だけを出すため、横スワイプ中でも HWHEEL が数十ms途切れることが
      ある。短すぎると積算がリセットされて発火しにくくなる。
      指を離した時点(BTN_TOUCH release)でも必ずリセットされる。

  throttle-ms:
    type: int
    default: 0
    description: |
      0 なら1回のスワイプで1回だけ発火する(指を離すまで再発火しない)。
      正の値にすると、スワイプを続けたままこの間隔で連続発火できる。

  pass-through:
    type: boolean
    description: |
      対象イベントを消費せず、後続のプロセッサにもそのまま流す。
      既定(無指定)ではイベントを消費する。
```
